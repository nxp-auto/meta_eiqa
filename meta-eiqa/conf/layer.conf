## meta-eiqa/conf/layer.conf
```bitbake
BBPATH .= ":${LAYERDIR}"

BBFILES += "${LAYERDIR}/recipes-*/*/*.bb ${LAYERDIR}/recipes-*/*/*.bbappend"

LICENSE_PATH += "${LAYERDIR}/custom-licenses"
EIQAUTO_LICENSE = "${LAYERDIR}/custom-licenses/LA_OPT_NXP_Software_License"

BBFILE_COLLECTIONS += "meta-eiqa"
BBFILE_PATTERN_meta-eiqa = "^${LAYERDIR}/"
BBFILE_PRIORITY_meta-eiqa = "11"

LAYERDEPENDS_meta-eiqa = "core"
LAYERSERIES_COMPAT_meta-eiqa = "dunfell gatesgarth"
```
